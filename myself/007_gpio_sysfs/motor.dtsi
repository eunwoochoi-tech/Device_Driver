/ {
	motors {
		pinctrl-names = "default";
		pinctrl-0 = <&motor1_default>;

		pwm {
			label = "motor,pwm";
			pwms = 
			//gpios = <&gpio2 17 GPIO_ACT>;
		};
	};
};

&am33xx_pinmux {
	motor1_default: motor1_default {
		pinctrl-single,pins = <
			0x48 0x06
		>;
	};
};
